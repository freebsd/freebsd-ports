DISTFILES+=	BitchX.theme
DISTFILES+=	IamCyan.theme
DISTFILES+=	agon.theme
DISTFILES+=	aka.theme
DISTFILES+=	artificial-soul.theme
DISTFILES+=	ash.theme
DISTFILES+=	asyura.theme
DISTFILES+=	bestican.theme
DISTFILES+=	bluu.theme
DISTFILES+=	bork.theme
DISTFILES+=	bw-wb-ryb.theme
DISTFILES+=	c0ders.theme
DISTFILES+=	cananal.theme
DISTFILES+=	chaves.theme
DISTFILES+=	chill.theme
DISTFILES+=	clean.theme
DISTFILES+=	crap.theme
DISTFILES+=	cross.theme
DISTFILES+=	crystal.theme
DISTFILES+=	cyanic.theme
DISTFILES+=	dark_winter.theme
DISTFILES+=	darksystem.theme
DISTFILES+=	daywalker.theme
DISTFILES+=	dbm.theme
DISTFILES+=	defacto.theme
DISTFILES+=	design.theme
DISTFILES+=	diskreet.theme
DISTFILES+=	doom.theme
DISTFILES+=	ea1.theme
DISTFILES+=	easyeye.theme
DISTFILES+=	ectobar.theme
DISTFILES+=	ekh.theme
DISTFILES+=	elite.theme
DISTFILES+=	elpi.theme
DISTFILES+=	en.theme
DISTFILES+=	envy.theme
DISTFILES+=	eon.theme
DISTFILES+=	epic.theme
DISTFILES+=	evilkat.theme
DISTFILES+=	evolution.theme
DISTFILES+=	evowhite.theme
DISTFILES+=	fluxmod.theme
DISTFILES+=	foo.theme
DISTFILES+=	foxmask.theme
DISTFILES+=	furry.theme
DISTFILES+=	garden.theme
DISTFILES+=	generane.theme
DISTFILES+=	gothic.theme
DISTFILES+=	green.theme
DISTFILES+=	greenSCPleo.theme
DISTFILES+=	greenbox.theme
DISTFILES+=	greenedge.theme
DISTFILES+=	greenish.theme
DISTFILES+=	greyed-out.theme
DISTFILES+=	h3rbz.theme
DISTFILES+=	hagge.theme
DISTFILES+=	hellfire.theme
DISTFILES+=	hnsk.theme
DISTFILES+=	hrncek.theme
DISTFILES+=	huara.theme
DISTFILES+=	hv.theme
DISTFILES+=	industrial.theme
DISTFILES+=	initrd.theme
DISTFILES+=	insane.theme
DISTFILES+=	ion.theme
DISTFILES+=	ion_mod.theme
DISTFILES+=	japsu.theme
DISTFILES+=	jokx.theme
DISTFILES+=	jsuvanto.theme
DISTFILES+=	kaer-2.theme
DISTFILES+=	kaer.theme
DISTFILES+=	koivula.theme
DISTFILES+=	kompakt.theme
DISTFILES+=	ksiadz.theme
DISTFILES+=	kurja-round.theme
DISTFILES+=	kurja.theme
DISTFILES+=	laaama-2.theme
DISTFILES+=	laaama.theme
DISTFILES+=	lemac-pl.theme
DISTFILES+=	lemac.theme
DISTFILES+=	lemmu.theme
DISTFILES+=	lenten.theme
DISTFILES+=	lesscolors.theme
DISTFILES+=	lighty.theme
DISTFILES+=	lilah.theme
DISTFILES+=	lime.theme
DISTFILES+=	liszt.theme
DISTFILES+=	litE.theme
DISTFILES+=	liten.theme
DISTFILES+=	lt.theme
DISTFILES+=	lyynx.theme
DISTFILES+=	madcow.theme
DISTFILES+=	madeye.theme
DISTFILES+=	magick.theme
DISTFILES+=	mazii.theme
DISTFILES+=	mika.theme
DISTFILES+=	mine.theme
DISTFILES+=	mirkk32.theme
DISTFILES+=	misso.theme
DISTFILES+=	mithru.theme
DISTFILES+=	more_readable.theme
DISTFILES+=	mork.theme
DISTFILES+=	mosdef.theme
DISTFILES+=	mrooveq.theme
DISTFILES+=	murf.theme
DISTFILES+=	mutru.theme
DISTFILES+=	n.theme
DISTFILES+=	naula.theme
DISTFILES+=	neutralorange.theme
DISTFILES+=	nitz.theme
DISTFILES+=	ocean.theme
DISTFILES+=	osbxwannabe.theme
DISTFILES+=	oscar.theme
DISTFILES+=	oxynox.theme
DISTFILES+=	pandemonium.theme
DISTFILES+=	parenthetical.theme
DISTFILES+=	pasce.theme
DISTFILES+=	pgreen.theme
DISTFILES+=	pikkuh.theme
DISTFILES+=	purplechat.theme
DISTFILES+=	pyhy.theme
DISTFILES+=	qlth.theme
DISTFILES+=	quubba.theme
DISTFILES+=	quux.theme
DISTFILES+=	rain.theme
DISTFILES+=	redhead.theme
DISTFILES+=	relaxed.theme
DISTFILES+=	rettoscopia.theme
DISTFILES+=	revolutionary.theme
DISTFILES+=	revolutionaryv2.theme
DISTFILES+=	revolutionaryv3.theme
DISTFILES+=	rolle.theme
DISTFILES+=	roses.theme
DISTFILES+=	salsa.theme
DISTFILES+=	scaleddown.theme
DISTFILES+=	screwer-redux.theme
DISTFILES+=	screwer.theme
DISTFILES+=	sfc1337.theme
DISTFILES+=	sfcblue.theme
DISTFILES+=	shrike.theme
DISTFILES+=	shruuf.theme
DISTFILES+=	simple.theme
DISTFILES+=	simpleii.theme
DISTFILES+=	simplicity.theme
DISTFILES+=	skan.theme
DISTFILES+=	skeita.theme
DISTFILES+=	ski.theme
DISTFILES+=	soppa.theme
DISTFILES+=	splitfire.theme
DISTFILES+=	spookydoom.theme
DISTFILES+=	spot.theme
DISTFILES+=	spring.theme
DISTFILES+=	sputnik.theme
DISTFILES+=	stevee.theme
DISTFILES+=	stx.theme
DISTFILES+=	sux.theme
DISTFILES+=	swehack.theme
DISTFILES+=	swift.theme
DISTFILES+=	syntax.theme
DISTFILES+=	tanke.theme
DISTFILES+=	telix.theme
DISTFILES+=	thirdeye.theme
DISTFILES+=	tinylajs.theme
DISTFILES+=	tonisepro.theme
DISTFILES+=	trakhel.theme
DISTFILES+=	trax.theme
DISTFILES+=	tugg.theme
DISTFILES+=	tzu.theme
DISTFILES+=	void.theme
DISTFILES+=	vt510+xterm.theme
DISTFILES+=	white.theme
DISTFILES+=	whitespace.theme
DISTFILES+=	xchat.theme
DISTFILES+=	xchat2.theme
DISTFILES+=	xmas.theme
DISTFILES+=	yellowsyntax.theme
DISTFILES+=	zhafte.theme
DISTFILES+=	zng.theme
