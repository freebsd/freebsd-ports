_PORT_REF_LIST= \
accessibility/at-spi-reference:at-spi-reference \
accessibility/atk-reference:atk-reference \
databases/libgda2-reference:libgda2-reference \
databases/libgda3-reference:libgda3-reference \
databases/libgnomedb-reference:libgnomedb-reference \
devel/ORBit2-reference:ORBit2-reference \
devel/gconf2-reference:gconf2-reference \
devel/glib20-reference:glib-reference \
devel/glibmm-reference:glibmm-reference \
devel/gnome-vfs-reference:gnome-vfs-reference \
devel/libbonobo-reference:libbonobo-reference \
devel/libglade2-reference:libglade2-reference \
devel/libsoup-reference:libsoup-reference \
graphics/cairo-reference:cairo-reference \
graphics/libgnomecanvas-reference:libgnomecanvas-reference \
net/linc-reference:linc-reference \
print/libgnomeprint-reference:libgnomeprint-reference \
textproc/gtkspell-reference:gtkspell-reference \
textproc/libxml2-reference:libxml2-reference \
textproc/libxslt-reference:libxslt-reference \
x11/gnome-desktop-reference:gnome-desktop-reference \
x11/gnome-panel-reference:gnome-panel-reference \
x11/libgnome-reference:libgnome-reference \
x11-fonts/fontconfig-reference:fontconfig-reference \
x11-toolkits/gal2-reference:gal2-reference \
x11-toolkits/gtk20-reference:gtk2-reference \
x11-toolkits/gtkmm20-reference:gtkmm20-reference \
x11-toolkits/gtkmm24-reference:gtkmm24-reference \
x11-toolkits/gtksourceview-reference:gtksourceview-reference \
x11-toolkits/libbonoboui-reference:libbonoboui-reference \
x11-toolkits/libgnomeui-reference:libgnomeui-reference \
x11-toolkits/libwnck-reference:libwnck-reference \
x11-toolkits/pango-reference:pango-reference \
x11-toolkits/vte-reference:vte-reference \
