## sysutils/u-boot-rpi3/files/patch-configs_rpi__3__defconfig
```kconfig
--- configs/rpi_3_defconfig.orig	2018-03-13 12:02:19 UTC
+++ configs/rpi_3_defconfig
@@ -13,9 +13,9 @@ CONFIG_SYS_PROMPT="U-Boot> "
 CONFIG_CMD_GPIO=y
 CONFIG_CMD_MMC=y
 CONFIG_CMD_USB=y
-CONFIG_OF_EMBED=y
+CONFIG_OF_BOARD=y
 CONFIG_ENV_FAT_INTERFACE="mmc"
-CONFIG_ENV_FAT_DEVICE_AND_PART="0:1"
+CONFIG_ENV_FAT_DEVICE_AND_PART="1:1"
 CONFIG_DM_KEYBOARD=y
 CONFIG_DM_MMC=y
 CONFIG_MMC_SDHCI=y
```

## sysutils/u-boot-sinovoip-bpi-m3/files/patch-configs_Sinovoip__BPI__M3__defconfig
```kconfig
--- configs/Sinovoip_BPI_M3_defconfig.orig	2016-05-16 11:40:32.000000000 -0300
+++ configs/Sinovoip_BPI_M3_defconfig	2016-07-07 17:05:19.339338000 -0300
@@ -32,3 +32,11 @@
 CONFIG_AXP_DLDO3_VOLT=2500
 CONFIG_USB_EHCI_HCD=y
 CONFIG_USB_MUSB_HOST=y
+
+# FreeBSD changes
+CONFIG_CMD_GPIO=y
+CONFIG_AXP_DCDC1_VOLT=3300
+CONFIG_AXP_DC1SW_EN=1
+# SATA port
+#CONFIG_INITIAL_USB_SCAN_DELAY=500
+#CONFIG_SYS_EXTRA_OPTIONS="SATAPWR=SUNXI_GPD(25)"
```
