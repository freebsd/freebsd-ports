--- language.inc.orig	2002-12-26 22:55:27.000000000 +0800
+++ language.inc	2002-12-27 17:12:45.000000000 +0800
@@ -2802,6 +2802,472 @@
   { 0, NULL }
 };
 
+struct translation translation_chinese_big5 [] = {
+  { 0, NULL },
+  {T__CHAR_SET, "BIG-5" },
+  {T__LANGUAGE, "Chinese (Traditional)" },
+  {T_BAD_NUMBER, "不合法的數字" },
+  {T_NUMBER_EXPECTED, "欄內應為數字" },
+  {T_CANCEL, "取消" },
+  {T_NUMBER_OUT_OF_RANGE, "數字超過範圍" },
+  {T_BAD_STRING, "不合法的字串" },
+  {T_EMPTY_STRING_NOT_ALLOWED, "字串長度不得為零" },
+  {T_CONFIG_ERROR, "設定錯誤" },
+  {T_UNABLE_TO_WRITE_TO_CONFIG_FILE, "無法寫入設定檔" },
+  {T_ABOUT, "關於 (A)" },
+  {T_LINKS__LYNX_LIKE, "Links " VERSION_STRING "\n\n文字與圖形介面 WWW 瀏覽器" },
+  {T_OK, "確定" },
+  {T_KEYS, "按鍵 (K)" },
+  {T_KEYS_DESC, "ESC       顯示選單\n^C, q     結束\n^P, ^N    向上/向下捲動\n[, ]      向左/向右捲動\nup, down  選擇超連結 (文字模式)\n->        移至連結 (文字模式)\n<-        上一頁 (文字模式)\nz         上一頁\ng         移至 url\nG         以目前 url 為基準，移至另一網頁\n^G        以目前超連結為基準，移至另一網頁\n/         尋找\n?         向文件開頭尋找\nn         找下一個\nN         找前一個\n=         文件資訊\n|         標頭資訊\n\\         文件原始碼\nd         下載\n^W        補齊 URL 或搜尋字串\n^Z, ^X, ^V 自剪貼簿複製、剪下、或貼上 (限 OS/2)\nAlt-1 .. Alt-9 切換頁面 (svgalib 與 framebuffer)" },
+  {T_COPYING, "複製資訊 (C)" },
+  {T_COPYING_DESC, "Links " VERSION_STRING "\n\n" LINKS_COPYRIGHT "\n\n 本程式為自由軟體；您可以依據 Free Software Foundation 所出版的\n GNU General Public 授權書來重新散佈或修改本軟體。\n您可以採用該授權的第二版或任何更新的版本。" },
+  {T_RESOURCES, "資源" },
+  {T_HANDLES, "handles" },
+  {T_TIMERS, "計時器" },
+  {T_CONNECTIONS, "連線" },
+  {T_cONNECTIONS, "連線" },
+  {T_CONNECTING, "正在連線" },
+  {T_tRANSFERRING, "正在傳輸" },
+  {T_KEEPALIVE, "保持連線" },
+  {T_MEMORY_CACHE, "記憶體快取" },
+  {T_FONT_CACHE, "字型快取" },
+  {T_BYTES, "位元組" },
+  {T_BYTES_MAX, "位元組 (最大)" },
+  {T_LETTERS, "letters" },
+  {T_FILES, "檔案" },
+  {T_LOCKED, "鎖定" },
+  {T_LOADING, "正在載入" },
+  {T_IMAGE_CACHE, "影像快取" },
+  {T_IMAGES, "影像" },
+  {T_FORMATTED_DOCUMENT_CACHE, "已格式化文件快取" },
+  {T_DOCUMENTS, "文件" },
+  {T_CACHE_INFO, "快取資訊" },
+  {T_CACHE_CONTENT, "快取內容" },
+  {T_MEMORY_ALLOCATED, "位元組記憶體已使用" },
+  {T_LAST, "last" },
+  {T_DIFFERENCE, "difference" },
+  {T_DIFFERENCES, "Differences" },
+  {T_NO_DIFFERENCES, "No differences" },
+  {T_NEW_ADDRESSES, "New addresses" },
+  {T_NO_NEW_ADDRESSES, "No new addresses" },
+  {T_MEMORY_INFO, "記憶體資訊 (M)" },
+  {T_MARK, "Mark" },
+  {T_NO_HISTORY, "沒有歷程資訊" },
+  {T_NO_DOWNLOADS, "沒有下載的檔案" },
+  {T_NO_FRAMES, "不使用邊框" },
+  {T_VT_100_FRAMES, "VT 100 邊框" },
+  {T_LINUX_OR_OS2_FRAMES, "Linux 或 OS/2 邊框" },
+  {T_KOI8R_FRAMES, "KOI8-R 邊框" },
+  {T_USE_11M, "使用 ^[[11m" },
+  {T_RESTRICT_FRAMES_IN_CP850_852, "只用 cp850/852 繪製邊框" },
+  {T_BLOCK_CURSOR, "塊狀游標" },
+  {T_COLOR, "使用色彩" },
+  {T_TERMINAL_OPTIONS, "終端機選項 (T)" },
+  {T_VIDEO_OPTIONS, "影像選項" },
+  {T_HTTP_PROXY__HOST_PORT, "HTTP 代理伺服器 (host:port)" },
+  {T_FTP_PROXY__HOST_PORT, "FTP 代理伺服器 (host:port)" },
+  {T_NOPROXY_LIST, "不使用代理伺服器的網域 (以逗號分隔)" },
+  {T_MAX_CONNECTIONS, "最大連線數量" },
+  {T_MAX_CONNECTIONS_TO_ONE_HOST, "對單一主機的最大連線數量" },
+  {T_RETRIES, "重試次數" },
+  {T_RECEIVE_TIMEOUT_SEC, "重試等待秒數" },
+  {T_TIMEOUT_WHEN_UNRESTARTABLE, "無法重試時等待秒數" },
+  {T_ASYNC_DNS_LOOKUP, "非同步 DNS 查詢" },
+  {T_SET_TIME_OF_DOWNLOADED_FILES, "保留所下載檔案的時間資訊" },
+  {T_NETWORK_OPTIONS, "網路選項 (N)" },
+  {T_MEMORY_CACHE_SIZE__KB, "記憶體快取大小 (kB)" },
+  {T_IMAGE_CACHE_SIZE__KB, "影像快取大小 (kB)" },
+  {T_NUMBER_OF_FORMATTED_DOCUMENTS, "已格式化文件數量" },
+  {T_CACHE_OPTIONS, "快取選項" },
+  {T_DISPLAY_TABLES, "顯示表格" },
+  {T_DISPLAY_FRAMES, "顯示頁框" },
+  {T_DISPLAY_IMAGES, "顯示影像" },
+  {T_DISPLAY_LINKS_TO_IMAGES, "顯示影像的連結" },
+  {T_LINK_ORDER_BY_COLUMNS, "在表格內以欄為基準移動" },
+  {T_NUMBERED_LINKS, "將連結編號" },
+  {T_TEXT_MARGIN, "文字邊界大小" },
+  {T_IGNORE_CHARSET_INFO_SENT_BY_SERVER, "忽略伺服器送出的字元集資訊" },
+  {T_HTML_OPTIONS, "Html 選項" },
+  {T_DEFAULT_CODEPAGE, "預設的字碼頁" },
+  {T_GOTO_URL, "移至 URL (G)" },
+  {T_GO_BACK, "上一頁 (B)" },
+  {T_HISTORY, "歷程 (H)" },
+  {T_RELOAD, "重新讀取 (R)" },
+  {T_SAVE_AS, "另存新檔 (V)" },
+  {T_SAVE_URL_AS, "另存 URL" },
+  {T_SAVE_FORMATTED_DOCUMENT, "儲存格式化後文件 (D)" },
+  {T_KILL_BACKGROUND_CONNECTIONS, "中止背景的連線 (K)" },
+  {T_FLUSH_ALL_CACHES, "清空所有快取 (F)" },
+  {T_RESOURCE_INFO, "系統資源 (I)" },
+  {T_OS_SHELL, "OS shell" },
+  {T_EXIT, "結束 (X)" },
+  {T_SEARCH, "尋找 (S)" },
+  {T_SEARCH_BACK, "向文件開頭尋找 (B)" },
+  {T_FIND_NEXT, "找下一個 (N)" },
+  {T_FIND_PREVIOUS, "找前一個 (P)" },
+  {T_TOGGLE_HTML_PLAIN, "切換 html/原始碼" },
+  {T_DOCUMENT_INFO, "文件資訊 (I)" },
+  {T_FRAME_AT_FULL_SCREEN, "全螢幕顯示頁框 (F)" },
+  {T_SAVE_HTML_OPTIONS, "儲存 html 選項 (A)" },
+  {T_ADD, "新增" },
+  {T_FOLDER, "資料夾" },
+  {T_fOLDER, "資料夾" },
+  {T_MODIFY, "修改" },
+  {T_DELETE, "刪除" },
+  {T_MOVE, "移動" },
+  {T_NO_ITEMS_SELECTED, "沒有選擇任何項目，無法移動。" },
+  {T_UNSELECT_ALL, "取消選擇" },
+  {T_CHARACTER_SET, "字元集 (H)" },
+  {T_CACHE, "快取 (C)" },
+  {T_MAIL_AND_TELNEL, "電子郵件與 telnet (M)" },
+  {T_ASSOCIATIONS, "檔案關聯 (A)" },
+  {T_FILE_EXTENSIONS, "檔案類型 (E)" },
+  {T_SAVE_OPTIONS, "儲存設定 (V)" },
+  {T_FILE, "檔案" },
+  {T_VIEW, "檢視" },
+  {T_LINK, "連結" },
+  {T_DOWNLOADS, "下載" },
+  {T_SETUP, "設定" },
+  {T_HELP, "求助" },
+  {T_ENTER_URL, "輸入 URL" },
+  {T_SAVE_URL, "儲存 URL" },
+  {T_DOWNLOAD, "下載" },
+  {T_SAVE_TO_FILE, "存到檔案" },
+  {T_SEARCH_FOR_TEXT, "尋找文字" },
+  {T_WAITING_IN_QUEUE, "等待中" },
+  {T_LOOKING_UP_HOST, "正在查詢主機" },
+  {T_MAKING_CONNECTION, "正在建立連線" },
+  {T_SSL_NEGOTIATION, "SSL 通訊" },
+  {T_REQUEST_SENT, "已送出請求" },
+  {T_GETTING_HEADERS, "正在取得標頭資訊" },
+  {T_LOGGING_IN, "正在登入" },
+  {T_SERVER_IS_PROCESSING_REQUEST, "伺服器正在處理請求" },
+  {T_TRANSFERRING, "傳送中" },
+  {T_WAITING_FOR_REDIRECT_CONFIRMATION, "正在等待 redirect 的確認" },
+  {T_INTERRUPTED, "中斷" },
+  {T_SOCKET_EXCEPTION, "Socket 例外" },
+  {T_INTERNAL_ERROR, "內部錯誤" },
+  {T_OUT_OF_MEMORY, "記憶體不足" },
+  {T_HOST_NOT_FOUND, "無法找到主機" },
+  {T_ERROR_WRITING_TO_SOCKET, "Socket 寫入錯誤" },
+  {T_ERROR_READING_FROM_SOCKET, "Socket 讀取錯誤" },
+  {T_DATA_MODIFIED, "資料已更改" },
+  {T_BAD_URL_SYNTAX, "無效的 URL 語法" },
+  {T_RECEIVE_TIMEOUT, "接收逾時" },
+  {T_REQUEST_MUST_BE_RESTARTED, "必須重新送出請求" },
+  {T_CANT_GET_SOCKET_STATE, "無法取得 socket 狀態" },
+  {T_BAD_HTTP_RESPONSE, "無效的 HTTP 回應" },
+  {T_HTTP_100, "HTTP 100 (\?\?\?)" },
+  {T_NO_CONTENT, "無內容" },
+  {T_UNKNOWN_FILE_TYPE, "未知的檔案類型" },
+  {T_ERROR_OPENING_FILE, "檔案開啟錯誤" },
+  {T_BAD_FTP_RESPONSE, "無效的 FTP 回應" },
+  {T_FTP_SERVICE_UNAVAILABLE, "FTP 服務無法使用" },
+  {T_BAD_FTP_LOGIN, "無效的 FTP 登入" },
+  {T_FTP_PORT_COMMAND_FAILED, "FTP PORT 指令失敗" },
+  {T_FILE_NOT_FOUND, "找不到檔案" },
+  {T_FTP_FILE_ERROR, "FTP file error" },
+  {T_UNKNOWN_ERROR, "未知的錯誤" },
+  {T_RECEIVED, "已接收" },
+  {T_OF, "of" },
+  {T_AVG, "avg" },
+  {T_CUR, "cur" },
+  {T_AVERAGE_SPEED, "平均速度" },
+  {T_SPEED, "速度" },
+  {T_CURRENT_SPEED, "目前速度" },
+  {T_ELAPSED_TIME, "已用時間" },
+  {T_ESTIMATED_TIME, "預估時間" },
+  {T_BACKGROUND, "背景" },
+  {T_ABORT, "中止" },
+  {T_YES, "是" },
+  {T_NO, "否" },
+  {T_DOWNLOAD_ERROR, "下載錯誤" },
+  {T_COULD_NOT_WRITE_TO_FILE, "無法建立檔案" },
+  {T_ERROR_DOWNLOADING, "下載發生錯誤: " },
+  {T_ERROR_LOADING, "讀取發生錯誤: " },
+  {T_COULD_NOT_CREATE_FILE, "無法建立檔案" },
+  {T_UNKNOWN_TYPE, "未知的 type" },
+  {T_CONTEN_TYPE_IS, "Content type 為" },
+  {T_HAS_TYPE, "has type" },
+  {T_DO_YOU_WANT_TO_OPEN_SAVE_OR_DISPLAY_THIS_FILE, "您要開啟、儲存或顯示此檔案？" },
+  {T_DO_YOU_WANT_TO_OPEN_OR_DISPLAY_THIS_FILE, "您要開啟或顯示此檔案？" },
+  {T_DO_YOU_WANT_TO_SAVE_OR_DISLPAY_THIS_FILE, "您要儲存或顯示此檔案？" },
+  {T_SAVE, "儲存" },
+  {T_DISPLAY, "顯示" },
+  {T_WHAT_TO_DO, "如何處理？" },
+  {T_DO_YOU_WANT_TO_OPEN_FILE_WITH, "您要用這個程式開啟檔案: " },
+  {T_SAVE_IT_OR_DISPLAY_IT, "儲存或顯示這個檔案？" },
+  {T_OPEN, "開啟" },
+  {T_OPEN_WITH, "用此程式開啟: " },
+  {T_DO_YOU_WANT_TO_FOLLOW_REDIRECT_AND_POST_FORM_DATA_TO_URL, "您是否要跟隨 redirect 的位址並把表單資料送到" },
+  {T_DO_YOU_WANT_TO_POST_FORM_DATA_TO_URL, "您是否要將表單資料送到" },
+  {T_DO_YOU_WANT_TO_REPOST_FORM_DATA_TO_URL, "您是否要重新傳送表單資料到" },
+  {T_WARNING, "警告" },
+  {T_ERROR, "錯誤" },
+  {T_WELCOME, "歡迎" },
+  {T_WELCOME_TO_LINKS, "歡迎使用 links!" },
+  {T_BASIC_HELP, "按 ESC 或用滑鼠點選視窗的最上端以顯示選單，選擇 [求助] -> [使用手冊] 以取得使用手冊。" },
+  {T_LABEL, "Label" },
+  {T_CONTENT_TYPES, "Content-Type(s)" },
+  {T_PROGRAM__IS_REPLACED_WITH_FILE_NAME, "程式 ('%' 會以檔名取代)" },
+  {T_BLOCK_TERMINAL_WHILE_PROGRAM_RUNNING, "在程式執行時暫停終端機" },
+  {T_RUN_ON_TERMINAL, "在終端機執行" },
+  {T_RUN_IN_XWINDOW, "在 X-Window 中執行" },
+  {T_ASK_BEFORE_OPENING, "開啟前先詢問" },
+  {T_DELETE_ASSOCIATION, "刪除檔案關聯" },
+  {T_ASSOCIATION, "關聯" },
+  {T_EXTENSION_S, "延伸檔名" },
+  {T_CONTENT_TYPE, "Content-Type" },
+  {T_DELETE_EXTENSION, "刪除檔案類型" },
+  {T_EXTENSION, "類型" },
+  {T_eXTENSION, "類型" },
+  {T_ERROR_WHILE_POSTING_FORM, "在傳送表單資訊時發生錯誤" },
+  {T_COULD_NOT_GET_FILE, "無法取得檔案" },
+  {T_NO_PREVIOUS_SEARCH, "沒有上一筆搜尋資料" },
+  {T_SEARCH_STRING_NOT_FOUND, "找不到要搜尋的字串" },
+  {T_SAVE_ERROR, "儲存錯誤" },
+  {T_ERROR_WRITING_TO_FILE, "寫入檔案發生錯誤: " },
+  {T_DISPLAY_USEMAP, "Display usemap" },
+  {T_FOLLOW_LINK, "跟隨連結 (F)" },
+  {T_OPEN_IN_NEW_WINDOW, "在新視窗開啟 (W)" },
+  {T_DOWNLOAD_LINK, "下載連結 (D)" },
+  {T_RESET_FORM, "重設表單" },
+  {T_SUBMIT_FORM, "傳送表單" },
+  {T_SUBMIT_FORM_AND_OPEN_IN_NEW_WINDOW, "傳送表單並開啟在新視窗" },
+  {T_SUBMIT_FORM_AND_DOWNLOAD, "傳送表單並下載" },
+  {T_VIEW_IMAGE, "觀看影像" },
+  {T_DOWNLOAD_IMAGE, "下載影像" },
+  {T_NO_LINK_SELECTED, "未選取連結" },
+  {T_IMAGE, "影像" },
+  {T_USEMAP, "Usemap" },
+  {T_SUBMIT_FORM_TO, "將表單送至" },
+  {T_POST_FORM_TO, "將表單 post 至" },
+  {T_RADIO_BUTTON, "Radio button" },
+  {T_CHECKBOX, "Checkbox" },
+  {T_SELECT_FIELD, "Select field" },
+  {T_TEXT_FIELD, "Text field" },
+  {T_TEXT_AREA, "Text area" },
+  {T_FILE_UPLOAD, "檔案上傳" },
+  {T_PASSWORD_FIELD, "Password field" },
+  {T_BUTTON, "按鈕" },
+  {T_NAME, "名稱" },
+  {T_VALUE, "值" },
+  {T_HIT_ENTER_TO, "按 Enter 以" },
+  {T_SUBMIT_TO, "傳送至" },
+  {T_POST_TO, "post 至" },
+  {T_INFO, "資訊" },
+  {T_HEADER_INFO, "標頭資訊" },
+  {T_YOU_ARE_NOWHERE, "您還沒有連到任何網頁啊！" },
+  {T_URL, "URL" },
+  {T_SIZE, "大小" },
+  {T_INCOMPLETE, "未完成" },
+  {T_CODEPAGE, "字碼頁" },
+  {T_ASSUMED, "被假設" },
+  {T_IGNORING_SERVER_SETTING, "忽略伺服器設定" },
+  {T_SERVER, "伺服器" },
+  {T_DATE, "日期" },
+  {T_LAST_MODIFIED, "最後更新" },
+  {T_LANGUAGE, "語言 (L)" },
+  {T_XTERM, "Xterm" },
+  {T_TWTERM, "Twterm" },
+  {T_SCREEN, "Screen" },
+  {T_WINDOW, "視窗" },
+  {T_FULL_SCREEN, "全螢幕" },
+  {T_BEOS_TERMINAL, "BeOS 終端機" },
+  {T_NEW_WINDOW, "新視窗 (N)" },
+  {T_GO_TO_LINK, "移至連結" },
+  {T_ENTER_LINK_NUMBER, "輸入連結號碼" },
+  {T_RESIZE_TERMINAL, "重新縮放 terminal" },
+  {T_COLUMNS, "欄" },
+  {T_ROWS, "列" },
+  {T_BOOKMARKS, "書籤 (s)" },
+  {T_BOOKMARK, "書籤" },
+  {T_ADD_BOOKMARK, "新增書籤" },
+  {T_ADD_ASSOCIATION, "新增檔案關聯" },
+  {T_ADD_EXTENSION, "新增檔案類型" },
+  {T_ADD_FOLDER, "新增資料夾" },
+  {T_GOTO, "衝了" },
+  {T_EDIT, "編輯" },
+  {T_CLOSE, "關閉" },
+  {T_BOOKMARK_TITLE, "書籤標題" },
+  {T_EDIT_BOOKMARK, "編輯書籤" },
+  {T_EDIT_ASSOCIATION, "編輯檔案關聯" },
+  {T_EDIT_EXTENSION, "編輯檔案類型" },
+  {T_DELETE_BOOKMARK, "刪除書籤" },
+  {T_EDIT_FOLDER, "編輯資料夾" },
+  {T_DELETE_FOLDER, "刪除資料夾" },
+  {T_NOT_EMPTY_SURE_DELETE, "不是空的。您真的要刪除嗎？" },
+  {T_BOOKMARK_MANAGER, "書籤管理員" },
+  {T_ASSOCIATIONS_MANAGER, "檔案關聯管理員" },
+  {T_EXTENSIONS_MANAGER, "檔案類型管理員" },
+  {T_url, "url" },
+  {T_NNAME, "名稱" },
+  {T_EXIT_LINKS, "結束 Links" },
+  {T_DO_YOU_REALLY_WANT_TO_EXIT_LINKS, "您真的要結束 Links 嗎？" },
+  {T_DO_YOU_REALLY_WANT_TO_EXIT_LINKS_AND_TERMINATE_ALL_DOWNLOADS, "您真的要結束 Links 而且停止所有的下載？" },
+  {T_HTTP_OPTIONS, "HTTP 選項" },
+  {T_FTP_OPTIONS, "FTP 選項" },
+  {T_HTTP_BUG_WORKAROUNDS, "使用 HTTP bug 的暫時解決方案" },
+  {T_USE_HTTP_10, "使用 HTTP/1.0" },
+  {T_FAKE_USERAGENT, "偽造 User-Agent" },
+  {T_FAKE_REFERER, "固定的 HTTP Referer" },
+  {T_REFERER_NONE, "不送出 referer 資訊" },
+  {T_REFERER_SAME_URL, "以要求的 URL 當作 referer 送出" },
+  {T_REFERER_REAL, "送出真實的 referer (一般的操作，不安全!!!)" },
+  {T_REFERER_FAKE, "固定的 referer:" },
+  {T_ALLOW_SERVER_BLACKLIST, "Allow blacklist of buggy servers" },
+  {T_BROKEN_302_REDIRECT, "Broken redirect 302 (it violates RFC, but it's compatible with Netscape)" },
+  {T_NO_KEEPALIVE_AFTER_POST_REQUEST, "No keepalive connection after POST request (some buggy PHP databases need it)" },
+  {T_PASSWORD_FOR_ANONYMOUS_LOGIN, "匿名登入所使用的密碼" },
+  {T_MANUAL, "使用者手冊 (M)" },
+  {T_HOMEPAGE, "首頁 (H)" },
+  {T_CALIBRATION, "微調 (I)" },
+  {T_MAILTO_PROG, "Mail program (% 會被電子郵件位址取代)" },
+  {T_TELNET_PROG, "Telnet 程式 (% 會被取代為 \"host\" 或 \"host port\")" },
+  {T_TN3270_PROG, "Tn3270 程式 (% 會被取代為 \"host\" or \"host port\")" },
+  {T_MAIL_AND_TELNET_PROGRAMS, "電子郵件和 telnet 程式" },
+  {T_NO_PROGRAM, "沒有程式" },
+  {T_NO_PROGRAM_SPECIFIED_FOR, "未有程式指定給 " },
+  {T_MAIL, "mail" },
+  {T_TELNET, "telnet" },
+  {T_TN3270, "tn3270" },
+  {T_BAD_MAILTO_URL, "無效的 mailto url" },
+  {T_BAD_TELNET_URL, "無效的 telnet url" },
+  {T_BAD_TN3270_URL, "無效的 tn3270 url" },
+  {T_USERID, "使用者 ID" },
+  {T_PASSWORD, "密碼" },
+  {T_ENTER_USERNAME, "輸入此站的使用者名稱: " },
+  {T_AT, " 在 " },
+  {T_SSL_ERROR, "SSL 錯誤" },
+  {T_NO_SSL, "本版本未包含 SSL/TSL 支援" },
+  {T_SURE_DELETE, "您確定要刪除" },
+  {T_BOOKMARKS_ALREADY_IN_USE, "書籤已在使用中！" },
+  {T_ASSOCIATIONS_ALREADY_IN_USE, "檔案關聯已在使用中！" },
+  {T_EXTENSIONS_ALREADY_IN_USE, "檔案類型已在使用中！" },
+  {T_VIDEO_OPTIONS_TEXT, "Recommended User gamma setting:\n 1.33 for dark room, 1.11 for very dim room, 1 form usual computer workspace lighting, 0.88 for bright environment lighting." },
+  {T_RED_DISPLAY_GAMMA, "Red display gamma" },
+  {T_GREEN_DISPLAY_GAMMA, "Green display gamma" },
+  {T_BLUE_DISPLAY_GAMMA, "Blue display gamma" },
+  {T_USER_GAMMA, "User gamma" },
+  {T_ALERT, "警告" },
+  {T_QUESTION, "問題" },
+  {T_KILL_SCRIPT, "中止 script" },
+  {T_KILL_ALL_SCRIPTS, "中止所有的 scripts" },
+  {T_SCRIPT_KILLED_BY_USER, "Javascript 被使用者中止。" },
+  {T_SCRIPT_TRYING_TO_CLOSE_WINDOW, "Javascript 正嘗試關閉視窗。您真的要關閉視窗嗎？" },
+  {T_ENTER_STRING, "輸入字串" },
+  {T_JAVASCRIPT_OPTIONS, "Javascript 選項" },
+  {T_ENABLE_JAVASCRIPT, "使用 javascript" },
+  {T_VERBOSE_JS_ERRORS, "詳細的 javascript 錯誤" },
+  {T_VERBOSE_JS_WARNINGS, "詳細的 javascript 警告" },
+  {T_MISCELANEOUS_OPTIONS, "其他設定 (O)" },
+  {T_JAVASCRIPT_ERROR, "Javascript 錯誤" },
+  {T_JAVASCRIPT_WARNING, "Javascript 警告" },
+  {T_DISMISS, "Dismiss" },
+  {T_MENU_FONT_SIZE, "Menu font size" },
+  {T_USER_FONT_SIZE, "User font size" },
+  {T_TURN_OFF_WARNINGS, "關閉警告訊息" },
+  {T_BOOKMARKS_ENCODING, "書籤編碼" },
+  {T_JS_IS_ATTEMPTING_TO_GO_TO_URL, "Javascript 正嘗試移至一 URL" },
+  {T_JS_IS_ATTEMPTING_TO_OPEN_NEW_WINDOW_WITH_URL, "Javascript 正嘗試在新視窗開啟 URL" },
+  {T_JS_IS_ATTEMPTING_TO_GO_INTO_HISTORY, "Javascript 正在嘗試跳至歷程紀錄" },
+  {T_TO_URL, "to url" },
+  {T_GOTO_HISTORY, "跳至歷程" },
+  {T_ALLOW, "允許\" },
+  {T_REJECT, "拒絕" },
+  {T_ENABLE_ALL_CONVERSIONS, "使用所有的轉換" },
+  {T_ENABLE_GLOBAL_NAME_RESOLUTION, "使用全域的名稱解析" },
+  {T_JS_RECURSION_DEPTH, "遞迴深度" },
+  {T_MENU_BACKGROUND_COLOR, "Background color" },
+  {T_MENU_FOREGROUND_COLOR, "Foreground color" },
+  {T_SCROLL_BAR_BAR_COLOR, "Scroll-bar bar color" },
+  {T_SCROLL_BAR_AREA_COLOR, "Scroll-bar area color" },
+  {T_SCROLL_BAR_FRAME_COLOR, "Scroll-bar frame color" },
+  {T_BOOKMARKS_FILE, "書籤檔案" },
+  {T_ENTER_COLORS_AS_RGB_TRIPLETS, "Enter colors as sRGB hexadecimal RRGGBB triplets." },
+  {T_JS_MEMORY_LIMIT_KB, "分配給 Javascript 的記憶體量 (kB)" },
+  {T_DITHER_LETTERS, "Dither letters" },
+  {T_DITHER_IMAGES, "Dither images" },
+  {T_SCALE_ALL_IMAGES_BY, "Scale all images by (%)" },
+  {T_DISPLAY_OPTIMIZATION_CRT,"Display optimization for CRT" },
+  {T_DISPLAY_OPTIMIZATION_LCD_RGB,"Display optimization for LCD (RGB)" },
+  {T_DISPLAY_OPTIMIZATION_LCD_BGR,"Display optimization for LCD (BGR)" },
+  {T_ASPECT_RATIO, "Aspect ratio" },
+  {T_ASPECT_CORRECTION_ON, "Aspect correction on" },
+  {T_KEYBOARD_CODEPAGE, "鍵盤的字碼頁" },
+  {T_HK_ADD_BOOKMARK, "A" },
+  {T_HK_BOOKMARKS, "S" },
+  {T_HK_GOTO_URL, "G" },
+  {T_HK_GO_BACK, "B" },
+  {T_HK_HISTORY, "H" },
+  {T_HK_RELOAD, "R" },
+  {T_HK_SAVE_AS, "V" },
+  {T_HK_SAVE_URL_AS, "U" },
+  {T_HK_SAVE_FORMATTED_DOCUMENT, "D" },
+  {T_HK_KILL_BACKGROUND_CONNECTIONS, "K" },
+  {T_HK_FLUSH_ALL_CACHES, "F" },
+  {T_HK_RESOURCE_INFO, "I" },
+  {T_HK_CACHE_INFO, "C" },
+  {T_HK_MAIL_AND_TELNEL, "M" },
+  {T_HK_MEMORY_INFO, "M" },
+  {T_HK_OS_SHELL, "O" },
+  {T_HK_RESIZE_TERMINAL, "T" },
+  {T_HK_EXIT, "X" },
+  {T_HK_SEARCH, "S" },
+  {T_HK_SEARCH_BACK, "B" },
+  {T_HK_FIND_NEXT, "N" },
+  {T_HK_FIND_PREVIOUS, "P" },
+  {T_HK_TOGGLE_HTML_PLAIN, "H" },
+  {T_HK_DOCUMENT_INFO, "I" },
+  {T_HK_FRAME_AT_FULL_SCREEN, "F" },
+  {T_HK_HTML_OPTIONS, "O" },
+  {T_HK_SAVE_HTML_OPTIONS, "A" },
+  {T_HK_ABOUT, "A" },
+  {T_HK_KEYS, "K" },
+  {T_HK_COPYING, "C" },
+  {T_HK_MANUAL, "M" },
+  {T_HK_HOMEPAGE, "H" },
+  {T_HK_CALIBRATION, "I" },
+  {T_HK_ADD, "A" },
+  {T_HK_MODIFY, "M" },
+  {T_HK_DELETE, "D" },
+  {T_HK_LANGUAGE, "L" },
+  {T_HK_CHARACTER_SET, "H" },
+  {T_HK_TERMINAL_OPTIONS, "T" },
+  {T_HK_VIDEO_OPTIONS, "V" },
+  {T_HK_NETWORK_OPTIONS, "N" },
+  {T_HK_CACHE, "C" },
+  {T_HK_ASSOCIATIONS, "A" },
+  {T_HK_FILE_EXTENSIONS, "E" },
+  {T_HK_SAVE_OPTIONS, "V" },
+  {T_HK_FILE, "F" },
+  {T_HK_VIEW, "V" },
+  {T_HK_LINK, "L" },
+  {T_HK_DOWNLOADS, "D" },
+  {T_HK_SETUP, "S" },
+  {T_HK_HELP, "H" },
+  {T_HK_DISPLAY_USEMAP, "U" },
+  {T_HK_FOLLOW_LINK, "F" },
+  {T_HK_OPEN_IN_NEW_WINDOW, "W" },
+  {T_HK_DOWNLOAD_LINK, "D" },
+  {T_HK_RESET_FORM, "R" },
+  {T_HK_SUBMIT_FORM, "S" },
+  {T_HK_SUBMIT_FORM_AND_OPEN_IN_NEW_WINDOW, "W" },
+  {T_HK_SUBMIT_FORM_AND_DOWNLOAD, "D" },
+  {T_HK_VIEW_IMAGE, "I" },
+  {T_HK_DOWNLOAD_IMAGE, "G" },
+  {T_HK_XTERM, "X" },
+  {T_HK_TWTERM, "T" },
+  {T_HK_SCREEN, "S" },
+  {T_HK_WINDOW, "W" },
+  {T_HK_FULL_SCREEN, "F" },
+  {T_HK_BEOS_TERMINAL, "B" },
+  {T_HK_NEW_WINDOW, "N" },
+  {T_HK_JAVASCRIPT_OPTIONS, "J" },
+  {T_HK_MISCELANEOUS_OPTIONS, "O" },
+  { 0, NULL }
+};
+
 struct translation translation_czech [] = {
   { 0, NULL },
   {T__CHAR_SET, "iso8859-2" },
@@ -13549,6 +14015,7 @@
   { translation_brazilian_portuguese },
   { translation_bulgarian },
   { translation_catalan },
+  { translation_chinese_big5 },
   { translation_croatian },
   { translation_czech },
   { translation_danish },
