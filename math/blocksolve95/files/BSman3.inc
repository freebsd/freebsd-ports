MAN3=	BSb_back_solve.3	\
	BSb_backward.3	\
	BSb_for_solve.3	\
	BSb_forward.3	\
	BSback_solve.3	\
	BSback_solve1.3	\
	BSbackward.3	\
	BSbackward1.3	\
	BSbjacobi.3	\
	BScopy_nz.3	\
	BScopy_par_mat.3	\
	BScreate_ctx.3	\
	BSctx_print.3	\
	BSctx_set_cs.3	\
	BSctx_set_ct.3	\
	BSctx_set_err.3	\
	BSctx_set_guess.3	\
	BSctx_set_id.3	\
	BSctx_set_is.3	\
	BSctx_set_max_it.3	\
	BSctx_set_method.3	\
	BSctx_set_np.3	\
	BSctx_set_num_rhs.3	\
	BSctx_set_pr.3	\
	BSctx_set_pre.3	\
	BSctx_set_print_log.3	\
	BSctx_set_ps.3	\
	BSctx_set_restart.3	\
	BSctx_set_rt.3	\
	BSctx_set_scaling.3	\
	BSctx_set_si.3	\
	BSctx_set_tol.3	\
	BSeasy_A.3	\
	BSfactor.3	\
	BSfinalize.3	\
	BSfor_solve.3	\
	BSfor_solve1.3	\
	BSforward.3	\
	BSforward1.3	\
	BSfree_comm.3	\
	BSfree_copy_par_mat.3	\
	BSfree_ctx.3	\
	BSfree_easymat.3	\
	BSfree_off_map.3	\
	BSfree_par_mat.3	\
	BSfree_reperm.3	\
	BSfree_spmat.3	\
	BSfreeg2l.3	\
	BSfreel2g.3	\
	BSget_diag.3	\
	BSglob2loc.3	\
	BSglob2proc.3	\
	BSglobal_flops.3	\
	BSglobal_nnz.3	\
	BSglobal_num_cliques.3	\
	BSglobal_num_inodes.3	\
	BSinit.3	\
	BSinv_diag_block.3	\
	BSloc2glob.3	\
	BSlocal_flops.3	\
	BSlocal_nnz.3	\
	BSlocal_num_cliques.3	\
	BSlocal_num_inodes.3	\
	BSmain_perm.3	\
	BSmain_reperm.3	\
	BSmake_off_map.3	\
	BSmat_subtract.3	\
	BSnum_colors.3	\
	BSoffset.3	\
	BSpar_gmres.3	\
	BSpar_isolve.3	\
	BSpar_solve.3	\
	BSpar_sym_solve.3	\
	BSprint_log.3	\
	BSsave_diag.3	\
	BSscale_diag.3	\
	BSset_diag.3	\
	BSset_diagv.3	\
	BSset_mat_icc_storage.3	\
	BSset_mat_symmetric.3	\
	BSsetup_block.3	\
	BSsetup_factor.3	\
	BSsetup_forward.3	\
	BStri_mult.3	\
	BStri_solve.3
