contents_DTD+= VERSION
contents_DTD+= xhtml-applet-1.mod
contents_DTD+= xhtml-arch-1.mod
contents_DTD+= xhtml-attribs-1.mod
contents_DTD+= xhtml-base-1.mod
contents_DTD+= xhtml-basic-form-1.mod
contents_DTD+= xhtml-basic-table-1.mod
contents_DTD+= xhtml-bdo-1.mod
contents_DTD+= xhtml-blkphras-1.mod
contents_DTD+= xhtml-blkpres-1.mod
contents_DTD+= xhtml-blkstruct-1.mod
contents_DTD+= xhtml-charent-1.mod
contents_DTD+= xhtml-csismap-1.mod
contents_DTD+= xhtml-datatypes-1.mod
contents_DTD+= xhtml-edit-1.mod
contents_DTD+= xhtml-events-1.mod
contents_DTD+= xhtml-form-1.mod
contents_DTD+= xhtml-frames-1.mod
contents_DTD+= xhtml-framework-1.mod
contents_DTD+= xhtml-hypertext-1.mod
contents_DTD+= xhtml-iframe-1.mod
contents_DTD+= xhtml-image-1.mod
contents_DTD+= xhtml-inlphras-1.mod
contents_DTD+= xhtml-inlpres-1.mod
contents_DTD+= xhtml-inlstruct-1.mod
contents_DTD+= xhtml-inlstyle-1.mod
contents_DTD+= xhtml-lat1.ent
contents_DTD+= xhtml-legacy-1.mod
contents_DTD+= xhtml-legacy-redecl-1.mod
contents_DTD+= xhtml-link-1.mod
contents_DTD+= xhtml-list-1.mod
contents_DTD+= xhtml-meta-1.mod
contents_DTD+= xhtml-nameident-1.mod
contents_DTD+= xhtml-notations-1.mod
contents_DTD+= xhtml-object-1.mod
contents_DTD+= xhtml-param-1.mod
contents_DTD+= xhtml-pres-1.mod
contents_DTD+= xhtml-qname-1.mod
contents_DTD+= xhtml-script-1.mod
contents_DTD+= xhtml-special.ent
contents_DTD+= xhtml-ssismap-1.mod
contents_DTD+= xhtml-struct-1.mod
contents_DTD+= xhtml-style-1.mod
contents_DTD+= xhtml-symbol.ent
contents_DTD+= xhtml-table-1.mod
contents_DTD+= xhtml-target-1.mod
contents_DTD+= xhtml-text-1.mod
contents_DTD+= xhtml.cat
contents_DTD+= xml1.dcl
contents_DTD+= xml1n.dcl

contents_DOC+= Overview.html
contents_DOC+= W3C-REC.css
contents_DOC+= abstract_modules.html
contents_DOC+= abstraction.html
contents_DOC+= acknowledgements.html
contents_DOC+= conformance.html
contents_DOC+= dtd_developing.html
contents_DOC+= dtd_module_defs.html
contents_DOC+= dtd_module_rules.html
contents_DOC+= goals.html
contents_DOC+= images/aqua.gif
contents_DOC+= images/black.gif
contents_DOC+= images/blue.gif
contents_DOC+= images/fuchsia.gif
contents_DOC+= images/gray.gif
contents_DOC+= images/green.gif
contents_DOC+= images/lime.gif
contents_DOC+= images/maroon.gif
contents_DOC+= images/navy.gif
contents_DOC+= images/olive.gif
contents_DOC+= images/purple.gif
contents_DOC+= images/red.gif
contents_DOC+= images/silver.gif
contents_DOC+= images/teal.gif
contents_DOC+= images/white.gif
contents_DOC+= images/yellow.gif
contents_DOC+= introduction.html
contents_DOC+= logo-REC.gif
contents_DOC+= references.html
contents_DOC+= schema_developing.html
contents_DOC+= schema_module_defs.html
contents_DOC+= schema_module_rules.html
contents_DOC+= terms.html
contents_DOC+= w3c_home.gif
contents_DOC+= wcag1AAA.gif
contents_DOC+= xhtml-modularization.html
contents_DOC+= xhtml-modularization.pdf
contents_DOC+= xhtml-modularization.ps
contents_DOC+= xhtml.css

contents_EXAMPLES+= MODULE-qname.mod
contents_EXAMPLES+= inventory-1.dtd
contents_EXAMPLES+= inventory-1.mod
contents_EXAMPLES+= inventory-newprefix.xml
contents_EXAMPLES+= inventory-prefixed.xml
contents_EXAMPLES+= inventory-qname-1.mod
contents_EXAMPLES+= inventory.xml
contents_EXAMPLES+= myml-1_0.dtd
contents_EXAMPLES+= myml-elements-1.mod
contents_EXAMPLES+= myml-model-1.mod
contents_EXAMPLES+= myml-noprefix.html
contents_EXAMPLES+= myml-prefixed.html
contents_EXAMPLES+= myml-qname-1.mod
contents_EXAMPLES+= simple-defaults.html
contents_EXAMPLES+= simple-newprefix.html
contents_EXAMPLES+= simple-prefixed.html
contents_EXAMPLES+= simpleml-1_0.dtd
contents_EXAMPLES+= simpleml-model-1.mod

contents_TEMPLATES+= template-1.mod
contents_TEMPLATES+= template-qname-1.mod
contents_TEMPLATES+= template.dtd
