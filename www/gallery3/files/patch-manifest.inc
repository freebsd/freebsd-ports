--- manifest.inc.orig	Thu Feb 12 03:15:35 2004
+++ manifest.inc	Thu Feb 12 09:54:28 2004
@@ -28,9 +28,6 @@
  */
 
 $versions=array();
-$versions['AUTHORS']='1.16';
-$versions['LICENSE.txt']='1.2';
-$versions['README']='1.28';
 $versions['Version.php']='1.573.2.13';
 $versions['add_comment.php']='1.29.2.2';
 $versions['add_photo.php']='1.18.6.1';
@@ -39,7 +36,6 @@
 $versions['album_permissions.php']='1.34.4.2';
 $versions['albums.php']='1.117.2.1';
 $versions['captionator.php']='1.37';
-$versions['configure.bat']='1.2';
 $versions['configure.sh']='1.4';
 $versions['copy_photo.php']='1.3.6.1';
 $versions['create_user.php']='1.30.6.1';
@@ -77,7 +73,6 @@
 $versions['rotate_photo.php']='1.37.6.1';
 $versions['save_photos.php']='1.80.6.1';
 $versions['search.php']='1.47.4.1';
-$versions['secure.bat']='1.2';
 $versions['secure.sh']='1.5';
 $versions['session.php']='1.26.8.1';
 $versions['slideshow.php']='1.46.2.1';
