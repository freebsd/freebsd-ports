CONFIGURE_ARGS=	--disable-software-xcb \
		--disable-software-xlib \
		--disable-software-8-x11 \
		--disable-software-16-x11 \
		--disable-directfb \
		--disable-software-16-sdl \
		--disable-gl-sdl \
		--disable-buffer \
		--disable-gl-xcb \
		--disable-gl-xlib \
		--disable-image-loader-bmp \
		--disable-image-loader-edb \
		--disable-image-loader-eet \
		--disable-image-loader-generic \
		--disable-image-loader-gif \
		--disable-image-loader-png \
		--disable-image-loader-ico \
		--disable-image-loader-jpeg \
		--disable-image-loader-pmaps \
		--disable-image-loader-psd \
		--disable-image-loader-svg \
		--disable-image-loader-tga \
		--disable-image-loader-tiff \
		--disable-image-loader-wbmp \
		--disable-image-loader-xpm \
		--disable-wayland-shm \
		--disable-wayland-egl \
		--disable-cpu-sse3

PATCHDIR=	"../../graphics/evas-core/files"
