# Common stuff for Licq-based ports
# $FreeBSD$

PKGNAMEPREFIX=		licq-
LICQ_VER=		1.2.3
QT_LICQ_VER=		1.2.3
RMS_LICQ_VER=		0.33
CONSOLE_LICQ_VER=	1.2.3
JONS_GTK_LICQ_VER=	0.20.1
.if ${PORTNAME} != "base"
RUN_DEPENDS+=		licq:${PORTSDIR}/net/licq
.endif
MASTER_SITES=		${MASTER_SITE_SOURCEFORGE}
MASTER_SITE_SUBDIR=	licq
DISTNAME=		${PKGNAMEPREFIX}${LICQ_VER}
DISTFILES=		${DISTNAME}.tar.bz2
GNU_CONFIGURE=		yes
MD5_FILE?=		${PORTSDIR}/net/licq/distinfo
# USE_LIBTOOL doesn't work for these ports
#USE_LIBTOOL=		yes
USE_GMAKE=		yes
USE_BZIP2=		yes
WRKSRC?=		${WRKDIR}/${DISTNAME}/plugins/${PORTNAME}
PLIST_SUB+=		LICQ_DEVEL="@comment "
.if ${OSVERSION} > 500030
CPPFLAGS+=		-Wno-deprecated
CONFIGURE_ENV+=		CPPFLAGS="${CPPFLAGS}"
MAKE_ENV+=		CPPFLAGS="${CPPFLAGS}"
.endif
